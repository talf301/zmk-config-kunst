## config/west.yml
```yaml
manifest:
  remotes:
    - name: talf301
      url-base: https://github.com/talf301
    - name: benvallack
      url-base: https://github.com/benvallack
  projects:
    - name: zmk
      remote: talf301
      revision: dongle-pr
      import: app/west.yml
  self:
    path: config
```
